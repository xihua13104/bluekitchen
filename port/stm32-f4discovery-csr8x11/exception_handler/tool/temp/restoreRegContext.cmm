r.s r0 0x0802e42f
r.s r1 0x0802e423
r.s r2 0x00000155
r.s r3 0xfffffff1
r.s r4 0x00000001
r.s r5 0x00000003
r.s r6 0x08020155
r.s r7 0x00000000
r.s r8 0x00000000
r.s r9 0x00000006
r.s r10 0x00000000
r.s r11 0x00000000
r.s r12 0x0803020c
r.s lr 0x0802018d
r.s pc 0x08020b08
r.s xpsr 0x210f0000
r.s CONTROL 0x00000004
r.s MSP 0x2001fec0
r.s PSP 0x00000000
r.s sp 0x2001fec0
r.s basepri 0x00000000
r.s primask 0x00000001
r.s faultmask 0x00000000
