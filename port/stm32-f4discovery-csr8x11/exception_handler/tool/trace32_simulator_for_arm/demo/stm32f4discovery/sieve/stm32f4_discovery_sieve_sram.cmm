;-----------------------------------------------------------------------------------
; @Title: Simple sieve demo running from SRAM for STM32F4xx derivatives
; @Description:
;   This is a small demo how to setup a SWD debug session on Cortex-M4
;   for STM32F4xx derivatives. The sieve demo is loaded on SRAM.
;   Prerequisites : see ../stm32f4/readme.txt
; @Keywords: Cortex-M4, debug, STM32, SWD
; @Author: HDA
; @Board: STM32F4DISCOVERY
; @Chip: STM32F4*
; @Copyright: (C) 1989-2019 Lauterbach GmbH, licensed for use with TRACE32(R) only
; --------------------------------------------------------------------------------
; $Id: stm32f4_discovery_sieve_sram.cmm 15217 2019-11-04 16:17:15Z bschroefel $

; Basic setup
  RESet
  SYStem.RESet
  SYStem.CPU STM32F407VG
  SYStem.CONFIG.DEBUGPORTTYPE SWD
  SYStem.MemAccess DAP
  SYStem.Option DUALPORT ON
  SYStem.Up

  Data.LOAD.auto ~~~~/demo_sram.axf

  Go.direct

  ; open some windows
  WinCLEAR

  WinPOS 0% 0% 50% 50%
  List.auto

  WinPOS 50% 0% 50% 50%
  Register.view /SpotLight

  WinPOS 0% 50% 50% 30%
  Frame /Locals /Caller

  WinPOS 0% 80% 50% 20%
  Var.Watch %E %SpotLight.on flags
  Var.AddWatch ast

  WinPOS 50% 50% 50% 50%
  Var.DRAW sinewave

  ENDDO