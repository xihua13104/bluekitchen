;Add some extra buttons to the toolbar

 menu.rp
 (
  add
  toolbar
  (
   separator
   toolitem "List Tracebuffer" ":alist" "Analyzer.List"
   separator
  )
 )


 ;change dir & Start the demo application
 chdir D:\study_material\bluekitchen\source_code\bluekitchen\port\stm32-f4discovery-csr8x11\exception_handler\tool
 do main.cmm

 HELP.FILTER.RESet
 HELP.FILTER.ADD    demo
 HELP.FILTER ON

 enddo

