r.s r0 0x0802716e
r.s r1 0x08030cfc
r.s r2 0x00000511
r.s r3 0xfffffff1
r.s r4 0x00000001
r.s r5 0x20006a28
r.s r6 0x00000000
r.s r7 0x0802c7ae
r.s r8 0x0802c77f
r.s r9 0x20006a20
r.s r10 0x00000000
r.s r11 0x00000000
r.s r12 0x08031c8c
r.s lr 0x08025be9
r.s pc 0x0802252c
r.s xpsr 0x01000000
r.s CONTROL 0x00000006
r.s MSP 0x2001ffe0
r.s PSP 0x20004460
r.s sp 0x20004460
r.s basepri 0x00000000
r.s primask 0x00000001
r.s faultmask 0x00000000
